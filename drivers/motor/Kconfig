## drivers/motor/Kconfig
```kconfig
config MOTOR_DRV_MAX77705
        tristate "Maxim MAX77705 motor"
        default n
        depends on MFD_MAX77705
        help
          If you say yes here you will get support for the
          motor of Maxim MAX77705 PMIC.
          To enable this driver, MFD_MAX77705 should be enabled and
          MFD_MAX77705 calls this driver.

config SS_VIBRATOR
	tristate "SS_VIBRATOR"
	default n
	help
	  Say Y to enable SAMSUNG VIBRATOR support
	  SS Vibrator
	  You will get supprot for that.

	  If unsure, say N.

config BOOST_POWER_SHARE
	bool "Boost Power Share"
	default n
	help
	  Say Y to enable Boost Power(5V) share.
```

## drivers/muic/Kconfig
```kconfig
#
# MUIC devices
#

comment "MUIC configs"

config USE_MUIC
	bool "Using MUIC device driver"
	default n
	help
	  If you say yes here you will get support for
	  the MUIC device driver.

config USE_SAFEOUT
	bool "Using SAFEOUT device driver"
	default n
	help
	  If you say yes here you will get support for
	  the SAFEOUT device driver.

config MUIC_NOTIFIER
	bool "MUIC notifier support"
	depends on USE_MUIC
	default n
	help
	  If you say yes here you will get support for
	  the MUIC attached device status change notification.

config MUIC_MAX77705
        bool "Using MAX77705 MUIC"
        depends on USE_MUIC
        default n
        help
          If you say yes here
	  you will get support
          for the MAX77705
	  MUIC chip.

config HV_MUIC_MAX77705_AFC
        bool "Using MAX77705 AFC MUIC"
        depends on MUIC_MAX77705
        default n
        help
	  If you say yes here
	  you will get support
	  for the MAX77705
	  AFC MUIC.

config MUIC_UNIVERSAL
	bool "UNIVERSAL MUIC"
	depends on USE_MUIC
	default n
	help
	  If you say yes here you will get support for various MUIC chips.

config MUIC_HV
	bool "MUIC_HV"
	depends on MUIC_UNIVERSAL
	default n
	help
	  If you say yes here you will get support for the AFC.

config MUIC_HV_12V
	bool "MUIC_HV_12V"
	depends on MUIC_HV
	default n
	help
	  If you say yes here you will get support for the AFC.

config SUPPORT_QC30
	bool "SUPPORT_QC30"
	default n
	help
	  If you say yes here you will get support for the QC3.0 charger.

config MUIC_SUPPORT_CCIC
	bool "MUIC supports CCIC chip interface"
	depends on USE_MUIC
	default n
	help
	  If you say yes here you will get support for the CCIC chip.

config MUIC_MAX77705_CCIC
        bool "Using MAX77705 MUIC supports CCIC chip interface"
        depends on MUIC_MAX77705
        default n
        help
          If you say yes here
	  you will get support
	  for the CCIC chip
	  with MAX77705 MUIC.

config MUIC_SUPPORT_RUSTPROOF
	bool "MUIC Disable UART"
	depends on !SEC_FACTORY
	default n
	help
	 This option will disable the UART to prevent the rusting of the
	 IF Connector in the case of Kmini Devices.

config MUIC_SUPPORT_VZW_ACC
	bool "MUIC supports VZW ACC"
	depends on MUIC_UNIVERSAL
	default n
	help
	 If you say yes here you will get support for the VZW Accessory & Incompatible.

config MUIC_SUPPORT_LANHUB
	bool "MUIC supports LANHUB"
	depends on MUIC_UNIVERSAL
	default n
	help
	 If you say yes here you will get support for the LANHUB.

config MUIC_SUPPORT_EARJACK
	bool "MUIC supports EARJACK"
	depends on MUIC_UNIVERSAL
	default n
	help
	 If you say yes here you will get support for the mUSB Earjack.

config MUIC_HV_FORCE_LIMIT
        bool "Force limit AFC QC MAX CHG VOLTAGE"
        depends on MUIC_UNIVERSAL_MAX77854
        default n
        help
          If you say yes here you will add function of limit afc charging volatage.

config HICCUP_CHARGER
	bool "Using HICCUP charger"
	depends on USE_MUIC
	default n
	help
		If you say yes here you will get support for
		for the hiccup charger feature.
```

## drivers/nfc/samsung/Kconfig
```kconfig
#
# Near Field Communication (NFC) devices
#

config SAMSUNG_NFC
	bool "Samsung NFC driver"
	default n
	help
	  Say Y here if you want to build support for NFC (Near field
	  communication) devices.
	  To compile this support as a module, choose M here: the module will
	  be called nfc.

menu "Samsung Near Field Communication (NFC) devices"
	depends on SAMSUNG_NFC

config SEC_NFC
	bool "Samsung NFC driver"
	default n
	help
	  SAMSUNG NFC Driver.
	  This driver provides support for SAMSUNG NFC products.
	  You should select your NFC product and interface.
	  Say Y here to compile support for SAMSUNG NFC driver into the
	  kernel.

config ESE_P3_LSI
        bool "LSI ese driver"
        depends on SPI
        default n
        help
          Gemalto Driver.
          This driver provides support for LSI NFC combined ESE products.
          You should select your NFC product and interface.

config ESE_SECURE
        bool "ese driver"
        depends on !SEC_FACTORY
        default n
        help
          eSE Driver.
          This driver provides support for ESE products.
          This option enables device spi communication
          via secured OS only.

config ESE_SPI_GPIO_START
        int "ese start num"
        default -1
        help
          eSE Driver.
          This driver provides support for ESE products.

config ESE_SPI_GPIO_END
        int "ese end num"
        default -1
        help
          eSE Driver.
          This driver provides support for ESE products.

config ESE_SPI_NUMBER
        int "ese bus num"
        default 99
        help
          eSE Driver.
          This driver provides support for ESE products.

config NFC_PN547
	bool "NXP PN547 Controller"
	default n
	help
	  NXP PN547 Near Field Communication controller support.
	  This option enables device driver support for the NFC.
	  It is used by many services. NFC is fully controlled using I2C
	  to communicate the AP chip.

config NFC_PN547_ESE_SUPPORT
	bool "NXP eSE Controller"
	default n
	help
	  NXP PN547 Near Field Communication controller support.
	  This option enables device driver support for the NFC.
	  It is used by many services. NFC is fully controlled using I2C
	  to communicate the AP chip.

source "drivers/nfc/samsung/nfc_logger/Kconfig"
endmenu
```

## drivers/samsung/Kconfig
```kconfig
config SEC_BSP
	bool "Samsung BSP Feature"
	default n
	select MSM_BOOT_STATS
	help
	  Samsung BSP Feature.

config SEC_PARAM
	bool "Enable Param modification"
	default y
	help
	  Samsung TN Param Feature.

config DRV_SAMSUNG
	tristate "Samsung sec class/sysfs Feature"
	default n
	help
	  Samsung sysfs name 'sec' directory create

menu "Samsung Factory Feature"
config SEC_FACTORY
	bool "when it comes to sec factory mode"
	default n
	select SEC_DEBUG_FORCE_ERROR
	select SEC_NAD
	select SEC_PANIC_PCIE_ERR
	help
	  It will support a sec factory mode
endmenu

source "drivers/samsung/debug/Kconfig"
source "drivers/samsung/misc/Kconfig"
```

## drivers/samsung/misc/Kconfig
```kconfig
#
# SAMSUNG device dedicated drivers
#
config SEC_MISC
	bool "Enable SEC miscellaneous feature"
	default y

config SAMSUNG_PRODUCT_SHIP
	bool "set up for product shipping"
	default n

config SEC_DEBUG_APPS_CLK_LOGGING
	bool "Enable apps clk logging"
	default n
	depends on CLOCK_CPU_OSM
	help
	  Enable apps clk logging.

config ARGOS
	bool "Throughput monitoring Feature"
	default n
	help
	  This option enables monitoring the data throughput and doing several actions for
	  enhancing the performance such as adjusting the CPU freqency, allocating the tasks
	  to the appropriate CPU and so on
```
